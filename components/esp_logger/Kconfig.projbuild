## components/esp_logger/Kconfig.projbuild
```kconfig
menu "Logger Config"

    config LOGGER_LOG_BUFFER_SIZE
        int "Log buffer ram size"
        default 16384

    config LOGGER_LOG_MAX_LOG_LINE_SIZE
        int "Max log line length size"
        default 128
    config LOGGER_LOG_MAX_TAG_SIZE
        int "Max log tag size"
        default 24
endmenu
```

## examples/esp-logger-example/sdkconfig.defaults
```kconfig
# Make sure no colors are added to the logs. This saves flash space, and colors will be added later with the printer.
CONFIG_LOG_COLORS=n
```
